## Kconfig
```
#
# Copyright (c) 2019 Nordic Semiconductor
#
# SPDX-License-Identifier: LicenseRef-Nordic-5-Clause
#

source "Kconfig.zephyr"

menu "Nordic Serial Modem"

config SM_CUSTOMER_VERSION
	string "Customer version string"
	help
	   This version is reported together with baseline versions by AT command "#XSMVER".

config SM_AT_BUF_SIZE
	int "AT command buffer size"
	range 128 8192
	default 4096
	help
	  Size of the buffer for incoming AT commands and modem responses.

#
# external XTAL for UART
#
config SM_EXTERNAL_XTAL
	bool "Use external XTAL for UARTE"
	default y

#
# AT command terminator
#
choice
	prompt "Termination mode"
	default SM_CR_TERMINATION
	help
	  Sets the command terminator used by the serial terminal.
	  Available options are:
	  -  CR termination
	  -  LF termination
	  -  CR+LF termination

config SM_CR_TERMINATION
	bool "CR termination"

config SM_LF_TERMINATION
	bool "LF termination"

config SM_CR_LF_TERMINATION
	bool "CR+LF termination"

endchoice

choice
	prompt "URC handling when CMUX is active"
	default SM_URC_FIRST_CHANNEL
	help
	  Sets the default behavior for handling URCs messages when CMUX is active.
	  When URC messages arrive from modem, if there are multiple channels in AT command mode,
	  the URCs will be sent according to the selected option.

	  Available options are:
	  - URCs are sent on the first CMUX channel
	  - URCs are sent on all CMUX channels

config SM_URC_FIRST_CHANNEL
	bool "Send URCs on the first CMUX channel"

config SM_URC_ALL_CHANNELS
	bool "Send URCs on all CMUX channels"

endchoice

#
# UART buffers (when CMUX is not in use)
#
config SM_UART_RX_BUF_COUNT
	int "Receive buffers for UART"
	range 2 4
	default 3
	help
	  Amount of buffers for receiving (RX) UART traffic.
	  If the buffers are full, UART RX will be disabled until the buffers are processed.
	  These buffers are not used when CMUX is in use.

config SM_UART_RX_BUF_SIZE
	int "Receive buffer size for UART"
	range 128 4096
	default 2048 if BOARD_THINGY91X_NRF9151_NS
	default 256
	help
	  Amount of received (RX), unprocessed, UART traffic that can be held by single buffer.
	  Increase buffer space for Thingy:91 X as hardware flow control is not used.
	  These buffers are not used when CMUX is in use.

config SM_UART_TX_BUF_SIZE
	int "Send buffer size for UART"
	range 128 4096
	default 256
	help
	  Amount of UART traffic waiting to be sent (TX), that can be held.
	  If the buffers are full, will send synchronously.
	  These buffers are not used when CMUX is in use.

config SM_URC_BUFFER_SIZE
	int "TX buffer size for unsolicited result codes (URC)"
	default 4096
	help
	  Buffer, in which unsolicited result codes (URC) are stored before being sent to the host.
	  The buffer has to be large enough to hold the largest URC that can be sent by the modem.
	  Result codes longer than this size will get dropped.

	  The URC in here means an URC from the Modem or from a thread which is not serving sm_work_queue.
	  Messages that are originally sent from sm_work_queue are part of AT-command responses, even though they are indistinguishable from the URCs.

	  This can be reduced if your use cases do not require lengthy notifications.
	  Note: %NCELLMEAS notifications can be nearly 4kB in size,
	  which explains the default value.

config SM_AT_ECHO_MAX_LEN
	int "Maximum length of AT command echo"
	range 2 4096
	default 4096
	help
	  Maximum length of AT command echo that will be sent back to the host when AT command echo is enabled.
	  AT commands longer than this value will be truncated in the echo.
	  The AT command terminator is included in this length and it is always echoed.

config SM_URC_DELAY_WITH_INCOMPLETE_ECHO_MS
	int "Delay for URC transmission when incomplete AT command echo is in progress (ms)"
	default 1000
	help
	  When AT command echo is enabled, and the command is spread over multiple RX buffers,
	  due to its length, or the speed of incoming data (typing), the command echo is considered incomplete
	  until the final part of the command (terminating character) has been received and echoed back to the host.

	  When the AT command echo is incomplete, URC transmissions are delayed by this amount of time for every
	  RX buffer (keystroke, while typing) received until the command echo is complete.

#
# Automatic network attach
#
config SM_AUTO_CONNECT
	bool "Automatically connect to the network on start-up or after a reset"
	help
	  Enables automatic connection to the network using the PDN configuration.

if SM_AUTO_CONNECT

config SM_AUTO_CONNECT_SYSTEM_MODE
	string "System mode for automatic network attach"
	default "1,1,1,0"
	help
	  Defines the default system mode using '%XSYSTEMMODE' AT command for automatic network attach.
	  The format is a comma-separated list of four integers. See the AT command reference for +XSYSTEMMODE for more details.
	  Default value enables LTE-M, NB-IoT, and GNSS, with no LTE preference.

config SM_AUTO_CONNECT_PDN_CONFIG
	bool "PDN configuration for automatic network attach"
	help
	  Enables sending of PDN configuration during automatic network attach.

if SM_AUTO_CONNECT_PDN_CONFIG

config SM_AUTO_CONNECT_PDN_APN
	string "APN for automatic network attach"
	default ""
	help
	  APN to use for automatic network attach.
	  If left empty, the APN configured in the modem will be used.

choice SM_AUTO_CONNECT_PDN_FAMILY
	prompt "PDN family (IP type) for automatic network attach"
	default SM_AUTO_CONNECT_PDN_FAMILY_IPV4V6
	help
	  Select the PDN family (IP address type) to use for automatic network attach.
	  See AT command reference for +CGDCONT for more details.

config SM_AUTO_CONNECT_PDN_FAMILY_IP
	bool "IPv4"
	help
	  Use IPv4 only for the PDN connection.

config SM_AUTO_CONNECT_PDN_FAMILY_IPV6
	bool "IPv6"
	help
	  Use IPv6 only for the PDN connection.

config SM_AUTO_CONNECT_PDN_FAMILY_IPV4V6
	bool "IPv4 and IPv6"
	help
	  Use both IPv4 and IPv6 for the PDN connection (dual stack).

config SM_AUTO_CONNECT_PDN_FAMILY_NON_IP
	bool "Non-IP"
	help
	  Use Non-IP PDN type for the connection.
	  This is used for data transmission without IP headers.

endchoice

config SM_AUTO_CONNECT_PDN_FAMILY_STRING
	string
	default "IP" if SM_AUTO_CONNECT_PDN_FAMILY_IP
	default "IPV6" if SM_AUTO_CONNECT_PDN_FAMILY_IPV6
	default "IPV4V6" if SM_AUTO_CONNECT_PDN_FAMILY_IPV4V6
	default "Non-IP" if SM_AUTO_CONNECT_PDN_FAMILY_NON_IP
	help
	  Internal use only. Represents the selected PDN family as a string.

config SM_AUTO_CONNECT_PDN_AUTH
	int "PDN authentication type for automatic network attach"
	default 0
	range 0 2
	help
	  PDN authentication type to use for automatic network attach.
	  0 = None
	  1 = PAP
	  2 = CHAP

config SM_AUTO_CONNECT_PDN_USERNAME
	string "PDN username for automatic network attach"
	default ""
	help
	  PDN username to use for automatic network attach.
	  Leave empty if no username is required.

config SM_AUTO_CONNECT_PDN_PASSWORD
	string "PDN password for automatic network attach"
	default ""
	help
	  PDN password to use for automatic network attach.
	  Leave empty if no password is required.

endif # SM_AUTO_CONNECT_PDN_CONFIG
endif # SM_AUTO_CONNECT

#
# Data mode
#
config SM_DATAMODE_TERMINATOR
	string "Pattern string to terminate data mode"
	default "+++"
	help
	  Use a pattern to terminate data mode

config SM_DATAMODE_BUF_SIZE
	int "Buffer size for data mode"
	range 1024 8192
	default 4096
	help
	  Size of the buffer for data received in data mode.

#
# Configurable services
#
config SM_SMS
	bool "SMS support"
	default y
	select SMS
	help
	  Support SMS send/receive in plain text

config SM_GNSS
	bool "GNSS support"
	default y

config SM_NRF_CLOUD
	bool "nRF Cloud support"
	default y
	select EXPERIMENTAL

if SM_NRF_CLOUD
config HEAP_MEM_POOL_ADD_SIZE_SM_NRF_CLOUD
	int "Additional heap memory pool size for nRF Cloud support"
	default 8192
	help
	  Some libraries used by nRF Cloud use System Heap (k_malloc() / k_free()) for
	  dynamic memory allocation.
endif # SM_NRF_CLOUD

config SM_NRF_CLOUD_LOCATION
	bool "nRF Cloud Location support"
	depends on SM_NRF_CLOUD
	help
	  Enable the nRF Cloud Location service for cloud-assisted geolocation.
	  Supports cellular and Wi-Fi positioning.

config SM_MQTTC
	bool "MQTT client support"
	default y
	select MQTT_LIB
	select MQTT_LIB_TLS
	select EXPERIMENTAL

config SM_FULL_FOTA
	bool "Full modem FOTA support"

config SM_DFU_MODEM_FULL
	bool "Full modem DFU support"

config SM_PPP
	bool "PPP support"

config SM_CMUX
	bool "CMUX support"

config SM_CMUX_CHANNEL_COUNT
	int "Number of CMUX channels"
	depends on SM_CMUX
	default 2
	range 1 63
	help
	  Number of channels to be used by the CMUX implementation.
	  Each channel adds about 4 kB of RAM usage for buffers.

if SM_PPP

config SM_PPP_FALLBACK_MTU
	int "Fallback MTU to be used by PPP"
	default 1280
	help
	  PPP tries to retrieve the cellular link MTU from the modem (using `AT+CGCONTRDP`).
	  If no MTU is returned by the modem, this value will be used as a fallback.
	  The MTU will be used for sending and receiving of data on both the PPP and cellular links.

endif # SM_PPP

if SM_CMUX || SM_PPP

config SM_MODEM_PIPE_TIMEOUT
	int "Timeout for the CMUX and PPP modem pipe operations in seconds"
	default 10

endif # SM_CMUX || SM_PPP

if SM_MQTTC

config SM_MQTTC_MESSAGE_BUFFER_LEN
	int "Size of the buffer for MQTT library"
	default 512
	help
	  Specifies maximum message size that can be transmitted/received through
	  MQTT (excluding MQTT PUBLISH payload).

endif # SM_MQTTC

if SM_GNSS

config SM_GNSS_OUTPUT_NMEA_SATELLITES
	bool "Output NMEA satellite messages (GSV, GSA)"
	default y if SM_LOG_LEVEL_DBG
	depends on SM_LOG_LEVEL_DBG
	help
	  If enabled, NMEA messages that pertain to the satellites will be output
	  along with the other NMEA messages. Those are output in debug logs.

config SM_PGPS_INJECT_FIX_DATA
	bool "Inject the data obtained when acquiring a fix"
	default y
	depends on SM_GNSS
	depends on SM_NRF_CLOUD
	depends on NRF_CLOUD_PGPS
	help
	  If enabled, when a fix is acquired the current location and time will
	  be passed to the P-GPS subsystem.
	  It allows to speed up the time it takes to acquire the next fix when
	  A-GNSS is disabled or unavailable.
	  This can be detrimental to short TTFF if the device is expected to move
	  distances longer than a few dozen kilometers between fix attempts.
	  In that case this option should be disabled.

endif # SM_GNSS

if NRF_MODEM_LIB_TRACE

choice NRF_MODEM_LIB_TRACE_BACKEND

config SM_MODEM_TRACE_BACKEND_CMUX
	bool "CMUX modem trace backend"
	depends on SM_CMUX_CHANNEL_COUNT > 2
	help
	  When CMUX is enabled, modem traces are transmitted on a dedicated CMUX channel.
	  The trace channel is the first channel after the AT command channel and the PPP channel.

endchoice # NRF_MODEM_LIB_TRACE_BACKEND

endif

#
# Hardware RX byte counting for UART
#
# Either hardware flow control OR hardware RX byte counting is required to prevent RX data loss.
# When hw-flow-control is enabled in devicetree, it handles flow management efficiently.
# When hw-flow-control is disabled, hardware RX byte counting is enabled to prevent data loss,
# but it consumes more power due to additional timer usage.
#
if UART_ASYNC_API

config UART_0_NRF_HW_ASYNC
	default y if HAS_HW_NRF_UARTE0 && !$(dt_nodelabel_bool_prop,uart0,hw-flow-control)

config UART_0_NRF_HW_ASYNC_TIMER
	default 0 if HAS_HW_NRF_UARTE0 && !$(dt_nodelabel_bool_prop,uart0,hw-flow-control)

config UART_2_NRF_HW_ASYNC
	default y if HAS_HW_NRF_UARTE2 && !$(dt_nodelabel_bool_prop,uart2,hw-flow-control)

config UART_2_NRF_HW_ASYNC_TIMER
	default 2 if HAS_HW_NRF_UARTE2 && !$(dt_nodelabel_bool_prop,uart2,hw-flow-control)

endif # UART_ASYNC_API

module = SM
module-str = serial modem
source "$(ZEPHYR_BASE)/subsys/logging/Kconfig.template.log_config"

rsource "src/lwm2m_carrier/Kconfig"

endmenu
```

## prj.conf
```kconfig
#
# Copyright (c) 2020 Nordic Semiconductor ASA
#
# SPDX-License-Identifier: LicenseRef-Nordic-5-Clause
#
# General config
CONFIG_LOG=y
CONFIG_ASSERT=y
CONFIG_ASSERT_VERBOSE=n
CONFIG_LOG_DEFAULT_LEVEL=3
CONFIG_STACK_SENTINEL=y
CONFIG_PICOLIBC_IO_FLOAT=y
CONFIG_RING_BUFFER=y
CONFIG_REBOOT=y
CONFIG_EVENTFD=y

# Segger RTT
CONFIG_USE_SEGGER_RTT=y
# Where console messages (printk) are output.
# By itself, SM does not output any.
CONFIG_RTT_CONSOLE=y
CONFIG_UART_CONSOLE=n
# Where logs are output.
CONFIG_LOG_BACKEND_RTT=y
CONFIG_LOG_BACKEND_UART=n
# Increase the buffer so that all Serial Modem boot logs fit into the buffer.
# Because J-Link RTT Viewer has to be connected after the bootup,
# only logs that fit into the buffer are shown. This is especially useful in showing
# errors if Serial Modem does not start properly.
CONFIG_SEGGER_RTT_BUFFER_SIZE_UP=2048

# Network
CONFIG_NETWORKING=y
CONFIG_NET_SOCKETS=y
CONFIG_NET_NATIVE=n
CONFIG_NET_IPV4=y
CONFIG_NET_IPV6=y

# Modem library
CONFIG_NRF_MODEM_LIB=y
CONFIG_AT_CMD_CUSTOM=y
# Align the max FD entry to NRF_MODEM_MAX_SOCKET_COUNT(8)
CONFIG_ZVFS_OPEN_MAX=8

# Modem pipe
CONFIG_MODEM_MODULES=y
CONFIG_MODEM_PIPE=y
CONFIG_MODEM_CMUX=y

# Handle modem fault
CONFIG_NRF_MODEM_LIB_ON_FAULT_APPLICATION_SPECIFIC=y

# Use GPIO
CONFIG_GPIO=y
CONFIG_GPIO_NRFX=y

# UART interface
CONFIG_SERIAL=y
CONFIG_UART_USE_RUNTIME_CONFIGURE=y
CONFIG_UART_ASYNC_API=y
CONFIG_UART_INTERRUPT_DRIVEN=n

# Stacks and heaps
CONFIG_MAIN_STACK_SIZE=4096
CONFIG_SYSTEM_WORKQUEUE_STACK_SIZE=4096
CONFIG_AT_MONITOR_HEAP_SIZE=4096

# Device power management
CONFIG_PM_DEVICE=y
CONFIG_PM_DEVICE_RUNTIME=n

# FOTA
CONFIG_HTTP_PARSER_URL=y
CONFIG_FOTA_DOWNLOAD=y
CONFIG_FOTA_DOWNLOAD_PROGRESS_EVT=y
CONFIG_DFU_TARGET=y
CONFIG_DOWNLOADER=y
CONFIG_DOWNLOADER_STACK_SIZE=4096
CONFIG_DOWNLOADER_MAX_FILENAME_SIZE=2048
CONFIG_BOOTLOADER_MCUBOOT=y
CONFIG_IMG_MANAGER=y

# FLASH
CONFIG_FLASH=y
CONFIG_FLASH_PAGE_LAYOUT=y
CONFIG_FLASH_MAP=y
CONFIG_STREAM_FLASH=y
CONFIG_MPU_ALLOW_FLASH_WRITE=y
CONFIG_IMG_ERASE_PROGRESSIVELY=y

# Settings
CONFIG_SETTINGS=y
CONFIG_SETTINGS_NVS=y
CONFIG_NVS=y

# nRF Cloud
CONFIG_NRF_CLOUD=y
CONFIG_NRF_CLOUD_MQTT=y
CONFIG_NRF_CLOUD_FOTA=n
CONFIG_NRF_CLOUD_AGNSS=y
CONFIG_NRF_CLOUD_AGNSS_FILTERED=n
CONFIG_NRF_CLOUD_PGPS=n
CONFIG_NRF_CLOUD_LOCATION=y
CONFIG_NRF_CLOUD_LOG_LEVEL_INF=y
CONFIG_NRF_CLOUD_GPS_LOG_LEVEL_INF=y
CONFIG_NRF_CLOUD_CLIENT_ID_SRC_INTERNAL_UUID=y
CONFIG_NRF_CLOUD_WIFI_LOCATION_ENCODE_OPT_MAC_RSSI=y
CONFIG_DATE_TIME=y
CONFIG_MODEM_INFO=y
CONFIG_MODEM_INFO_ADD_DATE_TIME=n

# UUID and JWT
CONFIG_MODEM_JWT=y

# MQTT client
#CONFIG_MQTT_KEEPALIVE=60
CONFIG_MQTT_CLEAN_SESSION=y

# AT command helper libraries
CONFIG_AT_PARSER=y
CONFIG_AT_MONITOR=y

# Eventfd's to use with AT-commands.
CONFIG_ZVFS_EVENTFD_MAX=2

# Disable TF-M logging.
# TF-M log sending will block until remote end is ready, when HWFC is used on UART1.
CONFIG_TFM_LOG_LEVEL_SILENCE=y

#
# SM-specific configurations
#
CONFIG_SM_CUSTOMER_VERSION=""
CONFIG_SM_EXTERNAL_XTAL=n

# debug options
#CONFIG_LOG_BUFFER_SIZE=16384
#CONFIG_SM_LOG_LEVEL_DBG=y
#CONFIG_LOG_PRINTK=n
#CONFIG_LOG_MODE_IMMEDIATE=y
#CONFIG_DEBUG_OPTIMIZATIONS=y
#CONFIG_DTR_UART_LOG_LEVEL_DBG=y

# For using external GNSS antenna
#CONFIG_MODEM_ANTENNA=y
#CONFIG_MODEM_ANTENNA_GNSS_EXTERNAL=y
```

## src/main.c
```c
/*
 * Copyright (c) 2019 Nordic Semiconductor ASA
 *
 * SPDX-License-Identifier: LicenseRef-Nordic-5-Clause
 */
#include <zephyr/logging/log.h>
#include <zephyr/kernel.h>
#include <nrf_modem.h>
#include <hal/nrf_power.h>
#include <modem/nrf_modem_lib.h>
#include <zephyr/dfu/mcuboot.h>
#include <dfu/dfu_target.h>
#include <zephyr/sys/reboot.h>
#include <zephyr/logging/log_ctrl.h>
#include <net/fota_download.h>
#include "sm_at_host.h"
#include "sm_at_dfu.h"
#include "sm_at_fota.h"
#include "sm_util.h"
#include "sm_ctrl_pin.h"
#include "sm_uart_handler.h"
#if defined(CONFIG_SM_HTTPC)
#include "sm_at_httpc.h"
#endif

LOG_MODULE_REGISTER(sm, CONFIG_SM_LOG_LEVEL);

struct k_work_q sm_work_q;
bool sm_init_failed = false;

NRF_MODEM_LIB_ON_INIT(lwm2m_init_hook, on_modem_lib_init, NULL);
NRF_MODEM_LIB_ON_DFU_RES(main_dfu_hook, on_modem_dfu_res, NULL);

static void on_modem_lib_init(int ret, void *ctx)
{
	ARG_UNUSED(ctx);

	/** ret: Zero on success, a positive value @em nrf_modem_dfu when executing
	 *  Modem firmware updates, and negative errno on other failures.
	 */
	LOG_INF("lib_modem init: %d", ret);
}

#if defined(CONFIG_NRF_MODEM_LIB_ON_FAULT_APPLICATION_SPECIFIC)
static struct nrf_modem_fault_info modem_fault_info;

static void on_modem_failure(struct k_work *)
{
	int ret;

	rsp_send("\r\n#XMODEM: FAULT,0x%x,0x%x\r\n", modem_fault_info.reason,
		 modem_fault_info.program_counter);

	ret = nrf_modem_lib_shutdown();
	rsp_send("\r\n#XMODEM: SHUTDOWN,%d\r\n", ret);

	ret = nrf_modem_lib_init();
	rsp_send("\r\n#XMODEM: INIT,%d\r\n", ret);
}
K_WORK_DEFINE(modem_failure_work, on_modem_failure);

void nrf_modem_fault_handler(struct nrf_modem_fault_info *fault_info)
{
	modem_fault_info = *fault_info;

	k_work_submit_to_queue(&sm_work_q, &modem_failure_work);
}
#endif /* CONFIG_NRF_MODEM_LIB_ON_FAULT_APPLICATION_SPECIFIC */

static void on_modem_dfu_res(int dfu_res, void *ctx)
{
	sm_fota_type = DFU_TARGET_IMAGE_TYPE_MODEM_DELTA;
	sm_fota_stage = FOTA_STAGE_COMPLETE;
	sm_fota_status = FOTA_STATUS_ERROR;
	sm_fota_info = dfu_res;

	switch (dfu_res) {
	case NRF_MODEM_DFU_RESULT_OK:
		LOG_INF("Modem update OK. Running new firmware.");
		sm_fota_status = FOTA_STATUS_OK;
		sm_fota_info = 0;
		break;
	case NRF_MODEM_DFU_RESULT_UUID_ERROR:
	case NRF_MODEM_DFU_RESULT_AUTH_ERROR:
		LOG_ERR("Modem update failed (0x%x). Running old firmware.", dfu_res);
		break;
	case NRF_MODEM_DFU_RESULT_HARDWARE_ERROR:
	case NRF_MODEM_DFU_RESULT_INTERNAL_ERROR:
		LOG_ERR("Fatal error (0x%x) encountered during modem update.", dfu_res);
		break;
	case NRF_MODEM_DFU_RESULT_VOLTAGE_LOW:
		LOG_ERR("Modem update postponed due to low voltage. "
			"Reset the modem once you have sufficient power.");
		sm_fota_stage = FOTA_STAGE_ACTIVATE;
		break;
	default:
		LOG_ERR("Unhandled nrf_modem DFU result code 0x%x.", dfu_res);
		break;
	}
}

static void check_app_fota_status(void)
{
	/** When a TEST image is swapped to primary partition and booted by MCUBOOT,
	 * the API mcuboot_swap_type() will return BOOT_SWAP_TYPE_REVERT. By this type
	 * MCUBOOT means that the TEST image is booted OK and, if it's not confirmed
	 * next, it'll be swapped back to secondary partition and original application
	 * image will be restored to the primary partition (so-called Revert).
	 */
	const int type = mcuboot_swap_type();

	switch (type) {
	/** Attempt to boot the contents of slot 0. */
	case BOOT_SWAP_TYPE_NONE:
		/* Normal reset, nothing happened, do nothing. */
		return;
	/** Swap to slot 1. Absent a confirm command, revert back on next boot. */
	case BOOT_SWAP_TYPE_TEST:
	/** Swap to slot 1, and permanently switch to booting its contents. */
	case BOOT_SWAP_TYPE_PERM:
	/** Swap failed because image to be run is not valid. */
	case BOOT_SWAP_TYPE_FAIL:
		sm_fota_status = FOTA_STATUS_ERROR;
		sm_fota_info = type;
		break;
	/** Swap back to alternate slot. A confirm changes this state to NONE. */
	case BOOT_SWAP_TYPE_REVERT:
		/* Happens on a successful application FOTA. */
		const int ret = boot_write_img_confirmed();

		sm_fota_info = ret;
		sm_fota_status = ret ? FOTA_STATUS_ERROR : FOTA_STATUS_OK;
		break;
	}
	sm_fota_type = DFU_TARGET_IMAGE_TYPE_MCUBOOT;
	sm_fota_stage = FOTA_STAGE_COMPLETE;
}

static int bootloader_mode_init(void)
{
	int ret;

	ret = nrf_modem_lib_bootloader_init();
	if (ret) {
		LOG_ERR("Failed to initialize bootloader mode: %d", ret);
		return ret;
	}
	LOG_INF("Bootloader mode initiated successfully");

	urc_send("Bootloader mode ready\r\n");

	sm_bootloader_mode_enabled = true;

	return 0;
}

void lte_auto_connect(void)
{
#if defined(CONFIG_SM_AUTO_CONNECT)
	int err;
	int n;
	int stat;

	err = sm_util_at_scanf("AT+CEREG?", "+CEREG: %d,%d", &n, &stat);
	if (err != 2 || (stat == 1 || stat == 5)) {
		return;
	}

	LOG_INF("LTE auto connect");
	LOG_DBG("Configuring system mode: %s", CONFIG_SM_AUTO_CONNECT_SYSTEM_MODE);
	err = sm_util_at_printf("AT%%XSYSTEMMODE=%s", CONFIG_SM_AUTO_CONNECT_SYSTEM_MODE);
	if (err) {
		LOG_ERR("Failed to configure system mode \"%s\": %d",
			CONFIG_SM_AUTO_CONNECT_SYSTEM_MODE, err);
		return;
	}

#if defined(CONFIG_SM_AUTO_CONNECT_PDN_CONFIG)
	err = sm_util_at_printf("AT+CGDCONT=0,%s,%s", CONFIG_SM_AUTO_CONNECT_PDN_FAMILY_STRING,
				CONFIG_SM_AUTO_CONNECT_PDN_APN);
	if (err) {
		LOG_ERR("Failed to configure PDN: %d", err);
		return;
	}
	LOG_DBG("PDN configured: APN=\"%s\", PDN type=\"%s\"", CONFIG_SM_AUTO_CONNECT_PDN_APN,
		CONFIG_SM_AUTO_CONNECT_PDN_FAMILY_STRING);

	if (CONFIG_SM_AUTO_CONNECT_PDN_AUTH != 0) {
		err = sm_util_at_printf("AT+CGAUTH=0,%d,%s,%s", CONFIG_SM_AUTO_CONNECT_PDN_AUTH,
					CONFIG_SM_AUTO_CONNECT_PDN_USERNAME,
					CONFIG_SM_AUTO_CONNECT_PDN_PASSWORD);
		if (err) {
			LOG_ERR("Failed to configure AUTH: %d", err);
			return;
		}
		LOG_DBG("PDN AUTH configured: protocol=%d, username=\"%s\"",
			CONFIG_SM_AUTO_CONNECT_PDN_AUTH, CONFIG_SM_AUTO_CONNECT_PDN_USERNAME);
	}
#endif /* CONFIG_SM_AUTO_CONNECT_PDN_CONFIG */

	err = sm_util_at_printf("AT+CFUN=1");
	if (err) {
		LOG_ERR("Failed to turn on radio: %d", err);
		return;
	}

#endif /* CONFIG_SM_AUTO_CONNECT */
}

static int init_sm_work_q(void)
{
	k_work_queue_init(&sm_work_q);
	return 0;
}
SYS_INIT(init_sm_work_q, PRE_KERNEL_1, 0);

int main(void)
{
	static const struct k_work_queue_config cfg = {
		.name = "sm_work_q",
		.essential = true,
	};

	k_thread_priority_set(k_current_get(), K_LOWEST_APPLICATION_THREAD_PRIO);
	k_work_queue_run(&sm_work_q, &cfg);
	return 0;
}

static int sm_main(void)
{
	int ret;

	const uint32_t rr = nrf_power_resetreas_get(NRF_POWER_NS);

	nrf_power_resetreas_clear(NRF_POWER_NS, 0x70017);
	LOG_DBG("RR: 0x%08x", rr);

	if (sm_bootloader_mode_requested) {
		/* Clear bootloader mode flag */
		ret = bootloader_mode_request(false);
		if (ret) {
			LOG_ERR("Failed to clear bootloader mode flag, starting SM in normal mode");
		} else {
			ret = bootloader_mode_init();
			if (ret) {
				LOG_ERR("Failed to initialize bootloader mode: %d", ret);
				goto exit_reboot;
			}
			return ret;
		}
	}

#if defined(CONFIG_SM_FULL_FOTA)
	if (sm_modem_full_fota) {
		sm_finish_modem_full_fota();
		sm_fota_type = DFU_TARGET_IMAGE_TYPE_FULL_MODEM;
	}
#endif

	ret = nrf_modem_lib_init();

	if (ret) {
		LOG_ERR("Modem library init failed, err: %d", ret);
		if (ret != -EAGAIN && ret != -EIO) {
			return ret;
		} else if (ret == -EIO) {
			LOG_ERR("Please program full modem firmware with the bootloader or "
				"external tools");
			(void)bootloader_mode_request(true);
			goto exit_reboot;
		}
	}

	check_app_fota_status();

	if (sm_init_failed) {
		urc_send(SM_SYNC_ERR_STR);
	} else {
		urc_send(SM_SYNC_STR);
	}

	/* This is here and not earlier because in case of firmware
	 * update it will send an AT response so the UART must be up.
	 */
	sm_fota_post_process();

	lte_auto_connect();

	LOG_INF("Serial Modem");

	return ret;

exit_reboot:
	LOG_PANIC();
	sys_reboot(SYS_REBOOT_COLD);
}
SYS_INIT(sm_main, APPLICATION, 100);
```

## src/sm_at_host.h
```c
/*
 * Copyright (c) 2019 Nordic Semiconductor ASA
 *
 * SPDX-License-Identifier: LicenseRef-Nordic-5-Clause
 */

#ifndef SM_AT_HOST_
#define SM_AT_HOST_

/** @file sm_at_host.h
 *
 * @brief AT host for Serial Modem
 * @{
 */

#include <zephyr/types.h>
#include <ctype.h>
#include <nrf_modem_at.h>
#include <modem/at_monitor.h>
#include <modem/at_cmd_custom.h>
#include <modem/at_parser.h>
#include "sm_defines.h"
#include <zephyr/modem/pipe.h>

/* This delay is necessary to send AT responses at low baud rates. */
#define SM_UART_RESPONSE_DELAY K_MSEC(50)

#define SM_DATAMODE_FLAGS_NONE	0
#define SM_DATAMODE_FLAGS_MORE_DATA (1 << 0)
#define SM_DATAMODE_FLAGS_EXIT_HANDLER (1 << 1)

/* This is needed for unit testing to allow static functions to be visible */
#if defined(CONFIG_UNITY)
#define STATIC
#else
#define STATIC static
#endif

/** @brief Operations in data mode. */
enum sm_datamode_operation {
	DATAMODE_SEND,  /* Send data in datamode */
	DATAMODE_EXIT   /* Exit data mode */
};

/** Forward declaration */
struct sm_at_host_ctx;

/** @brief Data mode handler callback function type.
 *
 * This callback is invoked to handle data mode operations (send data or exit).
 *
 * @param op Operation type: DATAMODE_SEND to send data, DATAMODE_EXIT to exit data mode.
 * @param data Data buffer to send (used when op is DATAMODE_SEND).
 * @param len Length of data in bytes (used when op is DATAMODE_SEND).
 * @param flags Operation flags (e.g., SM_DATAMODE_FLAGS_MORE_DATA, SM_DATAMODE_FLAGS_EXIT_HANDLER).

 *
 * @retval >=0 Number of bytes successfully sent.
 * @retval <0 Error, a negative errno code.
 */
typedef int (*sm_datamode_handler_t)(uint8_t op, const uint8_t *data, int len, uint8_t flags);

/** @brief Sends the given string via the current AT backend. */
int sm_at_send_str(const char *str);

/**
 * @brief Powers the UART down.
 *
 * @retval 0 on success, or a (negative) error code.
 */
int sm_at_host_power_off(void);

/** @brief Counterpart to @c sm_at_host_power_off(). */
int sm_at_host_power_on(void);

/**
 * @brief Uninitialize AT host for Serial Modem
 */
void sm_at_host_uninit(void);

/**
 * @brief Send AT command response
 *
 * @param fmt Response message format string
 *
 */
void rsp_send(const char *fmt, ...);

/**
 * @brief Send URC message
 *
 * URC messages are queued and sent when possible.
 *
 * @param fmt URC message format string
 *
 */
void urc_send(const char *fmt, ...);

/**
 * @brief Send AT command response of OK
 */
void rsp_send_ok(void);

/**
 * @brief Send AT command response of ERROR
 */
void rsp_send_error(void);

/**
 * @brief Send raw data received in data mode
 *
 * @param data Raw data received
 * @param len Length of raw data
 *
 */
void data_send(const uint8_t *data, size_t len);

/**
 * @brief Request Serial Modem AT host to enter data mode
 *
 * No AT unsolicited message or command response allowed in data mode.
 *
 * @param handler Data mode handler provided by requesting module
 * @param data_len Expected data length to be sent in data mode. 0 means unknown length and
 *        that the termination command is required to exit the data mode.
 *
 * @retval 0 If the operation was successful.
 *         Otherwise, a (negative) error code is returned.
 */
int enter_datamode(sm_datamode_handler_t handler, size_t data_len);

bool in_datamode_ctx(struct sm_at_host_ctx *ctx);
bool in_datamode_pipe(struct modem_pipe *pipe);
bool in_at_mode_ctx(struct sm_at_host_ctx *ctx);
bool in_at_mode_pipe(struct modem_pipe *pipe);
bool in_idle_ctx(struct sm_at_host_ctx *ctx);
bool in_idle_pipe(struct modem_pipe *pipe);

/**
 * @brief Check whether AT host context is in data mode
 *
 * @retval true if yes, false if no.
 */
#define in_datamode(X)                                                                             \
	_Generic((X),                                                                              \
		struct sm_at_host_ctx * : in_datamode_ctx,                                         \
		struct modem_pipe * : in_datamode_pipe                                             \
		)(X)

/**
 * @brief Check whether AT host context is in AT command mode
 *
 * @retval true if yes, false if no.
 */
#define in_at_mode(X)                                                                              \
	_Generic((X),                                                                              \
		struct sm_at_host_ctx * : in_at_mode_ctx,                                          \
		struct modem_pipe * : in_at_mode_pipe                                              \
		)(X)

/**
 * @brief Check whether AT host context is idle (in AT command mode and not processing any
 * command)
 *
 * @retval true if yes, false if no.
 */
#define in_idle(X)                                                                                 \
	_Generic((X),                                                                              \
		struct sm_at_host_ctx * : in_idle_ctx,                                             \
		struct modem_pipe * : in_idle_pipe                                                 \
		)(X)

#define is_open(X) \
		_Generic((X), \
			struct sm_at_host_ctx * : is_open_ctx, \
			struct modem_pipe * : is_open_pipe \
			)(X)

/**
 * @brief Exit the data mode handler
 *
 * Remove the callback to the data mode handler and start dropping the incoming data, until
 * the data mode is exited.
 *
 * @param result Result of sending in data mode.
 */
void exit_datamode_handler(int result);

/** @brief Serial Modem AT command callback type. */
typedef int sm_at_callback(enum at_parser_cmd_type cmd_type, struct at_parser *parser,
			    uint32_t param_count);

/**
 * @brief Generic wrapper for a custom Serial Modem AT command callback.
 *
 * This will call the AT command handler callback, which is declared with SM_AT_CMD_CUSTOM.
 *
 * @param buf Response buffer.
 * @param len Response buffer size.
 * @param at_cmd AT command.
 * @param cb AT command callback.

 * @retval 0 on success.
 */
int sm_at_cb_wrapper(char *buf, size_t len, char *at_cmd, sm_at_callback cb);

/**
 * @brief Enable or disable echo of received characters.
 *
 * @param enable True to enable echo, false to disable.
 */
void sm_at_host_echo(bool enable);

/** @brief Events which can be notified by the AT host. */
enum sm_event {
	SM_EVENT_NONE,           /**< No event. */
	SM_EVENT_URC = 0x01,     /**< URC can be sent. */
	SM_EVENT_AT_MODE = 0x02, /**< Entered AT command mode. */
};

/** @brief Event callback structure. */
struct sm_event_callback {
	sys_snode_t node;
	void (*cb)(struct k_work *work);
	enum sm_event events;
};

/**
 * @brief Register an event callback to be notified when the specified event occurs.
 * @param cb Pointer to the event callback structure.
 * @param event Event to register for.
 */
void sm_at_host_register_event_cb(struct sm_event_callback *cb, enum sm_event event);

/**
 * @brief Set the active modem pipe for AT communication.
 *
 * This allows switching between UART pipe (direct mode) and CMUX DLCI pipe.
 *
 * @param pipe Pointer to the modem_pipe to use for AT traffic.
 */
int sm_at_host_set_pipe(struct sm_at_host_ctx *ctx, struct modem_pipe *pipe);

/**
 * @brief Release the conxtext from associated pipe and mark for descruction.
 *
 * This detaches and releases the modem pipe from the AT host context
 * and mark the conxtext for descruction.
 *
 * @param ctx AT host context
 */
void sm_at_host_release(struct sm_at_host_ctx *ctx);

/**
 * @brief Attach a modem pipe to AT host module.
 *
 * If the pipe is already open, triggers the context creation immediately.
 * Otherwise, the context will be created when the pipe is opened.
 *
 * @param pipe Modem pipe to attach.
 */
void sm_at_host_attach(struct modem_pipe *pipe);

/**
 * @brief Get the modem pipe associated with the given AT host context.
 *
 * @param ctx AT host context
 * @return struct modem_pipe* or NULL if none is set.
 */
struct modem_pipe *sm_at_host_get_pipe(struct sm_at_host_ctx *ctx);


/** @brief Get the AT host context associated with a given modem pipe. */
struct sm_at_host_ctx *sm_at_host_get_ctx_from(struct modem_pipe *pipe);

/**
 * @brief Get the AT host context for URC transmission.
 *
 * URCs are always sent to the first (primary) instance.
 *
 * @return Pointer to first AT host context
 */
struct sm_at_host_ctx *sm_at_host_get_urc_ctx(void);

/**
 * @brief Get the current AT host context.
 *
 * Returns the context of the currently executing AT command/work.
 * Falls back to first instance if no context is currently active.
 *
 * The returned context is only valid during the execution of an AT command.
 *
 * WARNING: Do not store the returned pointer as it may become invalid
 *          when the context is destroyed.
 *          Use sm_at_host_get_current_pipe() instead.
 *
 * @return Pointer to current AT host context
 */
struct sm_at_host_ctx *sm_at_host_get_current(void);

/**
 * @brief Get the modem pipe associated with the current AT host context.
 *
 * @return struct modem_pipe* or NULL if no active context or pipe is set.
 */
static inline struct modem_pipe *sm_at_host_get_current_pipe(void)
{
	return sm_at_host_get_pipe(sm_at_host_get_current());
}

/**
 * @brief Get the modem pipe associated with the URC AT host context.
 *
 * There is no promise that the returned pipe is open, or in AT command mode.
 * On most cases, you should use urc_send() to send URCs.
 *
 * @return struct modem_pipe*
 */
static inline struct modem_pipe *sm_at_host_get_urc_pipe(void)
{
	return sm_at_host_get_pipe(sm_at_host_get_urc_ctx());
}

/**
 * @brief Submit a work to be executed when the current AT command processing is done.
 *
 * If the pipe is not currently processing an AT command, the work will be executed immediately.
 * Execution happens in the SM work queue context with the AT host context of the current pipe,
 * so sm_at_host_get_current() will return the correct context.
 *
 * @param pipe Modem pipe to associate the work with.
 * @param handler Work handler to be executed.
 */
void sm_at_host_queue_idle_work(struct modem_pipe *pipe, struct k_work *work);

/**
 * @brief Define a wrapper for a Serial Modem custom AT command callback.
 *
 * Wrapper will call the generic wrapper, which will call the actual AT command handler.
 *
 * @param entry The entry name.
 * @param _filter The (partial) AT command on which the callback should trigger.
 * @param _callback The AT command handler callback.
 *
 */
#define SM_AT_CMD_CUSTOM(entry, _filter, _callback)                                                \
	STATIC int _callback(enum at_parser_cmd_type cmd_type, struct at_parser *parser,           \
			     uint32_t param_count);                                                \
	STATIC int _callback##_wrapper_##entry(char *buf, size_t len, char *at_cmd)                \
	{                                                                                          \
		return sm_at_cb_wrapper(buf, len, at_cmd, _callback);                              \
	}                                                                                          \
	AT_CMD_CUSTOM(entry, _filter, _callback##_wrapper_##entry);

/** @} */

#endif /* SM_AT_HOST_ */
```

## src/sm_at_socket.h
```c
/*
 * Copyright (c) 2026 Nordic Semiconductor ASA
 *
 * SPDX-License-Identifier: LicenseRef-Nordic-5-Clause
 */

#ifndef SM_AT_SOCKET_H_
#define SM_AT_SOCKET_H_

/** @file sm_at_socket.h
 *
 * @brief Definitions for AT commands related to socket operations in Serial Modem
 */

#include <stdint.h>
#include <zephyr/kernel.h>
#include "sm_at_host.h"

/**
 * @brief Polling context for asynchronous socket events.
 *
 * This structure holds flags and work item and its going to be
 * defined for each AT host context.
 */
struct async_poll_ctx {
	struct k_work poll_work;         /**< Work to send poll URCs. */
	uint8_t xapoll_events_requested; /**< Events requested for all the sockets for async poll */
	uint8_t adr_flags;               /**< Auto reception flags for all sockets. */
	bool adr_hex: 1;                 /**< Auto reception hex mode for all sockets. */
};

/**
 * @brief Get the asynchronous poll context associated with the given modem pipe.
 *
 * This returns the async_poll_ctx associated with the AT host context that is attached to the given
 * modem pipe.
 *
 * When there is no AT host context attached to the given pipe, or the pipe is NULL, this returns
 * NULL.
 *
 * @param pipe The modem pipe for which to get the async poll context.
 * @return struct async_poll_ctx* poll context for the given modem pipe or NULL if no AT host
 * context is attached to the pipe.
 */
struct async_poll_ctx *sm_at_host_get_async_poll_ctx(struct modem_pipe *pipe);

/**
 * @brief Handler for asynchronous socket poll work.
 *
 * This function is called when the poll work item is executed. It processes
 * asynchronous socket events for the associated AT host context.
 * It should not be called directly, but will be initialized as a work item handler in the AT host
 * context.
 *
 * @param work Work item associated with the asynchronous poll.
 */
void sm_at_socket_poll_work_handler(struct k_work *work);

#endif /* SM_AT_SOCKET_H_ */
```
